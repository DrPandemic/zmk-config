## boards/shields/corne_dongle/Kconfig.defconfig
```kconfig
if SHIELD_CORNE_DONGLE

config ZMK_SPLIT
    default y

config ZMK_BLE
    default y

config ZMK_SPLIT_ROLE_CENTRAL
    default y

endif # SHIELD_CORNE_DONGLE
```
