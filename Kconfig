## boards/shields/corne_right_trackpad/Kconfig.shield
```kconfig
config SHIELD_CORNE_RIGHT_TRACKPAD
    def_bool $(shields_list_contains,corne_right_trackpad)
```

## config/west.yml
```yaml
manifest:
  remotes:
    - name: zmkfirmware
      url-base: https://github.com/zmkfirmware
    - name: aym1607
      url-base: https://github.com/AYM1607
    - name: zampierilucas
      url-base: https://github.com/zampierilucas
  projects:
    - name: zmk
      remote: zampierilucas
      revision: 70536371a6b25a03e2d534cd88801284d3a8edb7
      import: app/west.yml
    - name: zmk-driver-azoteq-iqs5xx
      remote: aym1607
      revision: 27321f0232b50f0af31eb27ff97d539933467ea4
  self:
    path: config
```
